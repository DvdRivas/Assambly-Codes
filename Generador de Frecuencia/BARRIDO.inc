;------- Declaracion de variables --------;
;;;;;;;;;;;;;;;;;;;;;;;;;;;;;;;;;;;;;;;;;;;
	CBLOCK
	ANTERIOR
	ENDC
;======================================================================================
BARRIDO
	BCF		INTCON,GIE
	CLRF	CAMBIO
	
	;FILA 4 ////////////////////////////////////////////////////////////////
	MOVLW 0XF0
	MOVWF	LATB
	BCF		LATB,4

	BTFSC	PORTB,RB0 ; TECLA 1
	GOTO	NEXT0
	BSF	CAMBIO,0
	MOVLW	0XFA
	MOVWF	CH
	MOVLW	0X45 
	MOVWF	CL
	MOVLW	'1'
	MOVWF	TEMP
	GOTO	FINBARRIDO
NEXT0
	BTFSC	PORTB,RB1 ; TECLA 4
	GOTO	NEXTGATO
	BSF	CAMBIO,0
	MOVLW	0XFE
	MOVWF	CH
	MOVLW	0XA8
	MOVWF	CL
	MOVLW	'4'
	MOVWF	TEMP
	GOTO	FINBARRIDO
NEXTGATO
	BTFSC	PORTB,RB2 ; TECLA 7
	GOTO	NEXTD
	BSF	CAMBIO,0
	MOVLW	0XFF
	MOVWF	CH
	MOVLW	0X40
	MOVWF	CL
	MOVLW	'7'
	MOVWF	TEMP
	GOTO	FINBARRIDO
NEXTD	
	BTFSC	PORTB,RB3 ; TECLA NO USADA
	GOTO	NEXTF1
	BSF	CAMBIO,0
	MOVLW	'D'
	MOVWF	TEMP
	GOTO	FINBARRIDO

NEXTF1	;FILA1 ////////////////////////////////////////////////////////////
	BSF		LATB,4
	BCF		LATB,7

	BTFSC	PORTB,RB0; TECLA A
	GOTO	NEXT2
	BSF	CAMBIO,0
	MOVLW	'A'
	MOVWF	TEMP
	BSF	CAMBIO,0
	GOTO 	FINBARRIDO
NEXT2
	BTFSC	PORTB,RB1 ; TECLA B
	GOTO	NEXT3
	BSF	CAMBIO,0
	MOVLW	'B'
	MOVWF	TEMP	
	GOTO 	FINBARRIDO
NEXT3
	BTFSC	PORTB,RB2 ; TECLA C
	GOTO	NEXTA
	BSF	CAMBIO,0
	MOVLW	'0'
	MOVWF	TEMP	
	GOTO 	FINBARRIDO
NEXTA
	BTFSC	PORTB,RB3 ; TECLA NO USADA
	GOTO	NEXTF2
	BSF	CAMBIO,0
	MOVLW	'1'
	MOVWF	TEMP	
	GOTO 	FINBARRIDO

NEXTF2	;FILA 2 ////////////////////////////////////////////////////////////
	BSF		LATB,7
	BCF		LATB,6

	BTFSC	PORTB,RB0 ; TECLA 3
	GOTO	NEXT5
	BSF	CAMBIO,0
	MOVLW	0XFE
	MOVWF	CH
	MOVLW	0X22
	MOVWF	CL
	MOVLW	'3'
	MOVWF	TEMP
	GOTO 	FINBARRIDO
NEXT5
	BTFSC	PORTB,RB1 ; TECLA 6
	GOTO	NEXT6
	BSF	CAMBIO,0
	MOVLW	0XFF
	MOVWF	CH
	MOVLW	0X23
	MOVWF	CL
	MOVLW	'6'
	MOVWF	TEMP
	GOTO 	FINBARRIDO
NEXT6
	BTFSC	PORTB,RB2 ; TECLA 9
	GOTO	NEXTB
	BSF	CAMBIO,0
	MOVLW	0XFF
	MOVWF	CH
	MOVLW	0X71
	MOVWF	CL
	MOVLW	'9'
	MOVWF	TEMP
	GOTO 	FINBARRIDO
NEXTB
	BTFSC	PORTB,RB3 ; TECLA NO USADA
	GOTO	NEXTF3
	BSF	CAMBIO,0
	MOVLW	'B'
	MOVWF	TEMP	
	GOTO 	FINBARRIDO

NEXTF3	;FILA 3 ////////////////////////////////////////////////////////////
	BSF		LATB,6
	BCF		LATB,5

	BTFSC	PORTB,RB0 ; TECLA 2
	GOTO	NEXT8
	BSF	CAMBIO,0
	MOVLW	0XFD
	MOVWF	CH
	MOVLW	0X2F
	MOVWF	CL
	MOVLW	'2'
	MOVWF	TEMP
	GOTO 	FINBARRIDO
NEXT8		
	BTFSC	PORTB,RB1 ; TECLA 5
	GOTO	NEXT9
	BSF	CAMBIO,0
	MOVLW	0XFE
	MOVWF	CH
	MOVLW	0XED
	MOVWF	CL
	MOVLW	'5'
	MOVWF	TEMP
	GOTO 	FINBARRIDO
NEXT9	
	BTFSC	PORTB,RB2 ; TECLA 8
	GOTO	NEXTC
	BSF	CAMBIO,0
	MOVLW	0XFF
	MOVWF	CH
	MOVLW	0X5B
	MOVWF	CL
	MOVLW	'8'
	MOVWF	TEMP
NEXTC
	BTFSC	PORTB,RB3 ; TECLA NO USADA
	GOTO	FINBARRIDO
	BSF	CAMBIO,0
	MOVLW	'C'
	MOVWF	TEMP	
	GOTO 	FINBARRIDO
FINBARRIDO
	MOVF	TEMP,W
	MOVWF	CARACTER
NEWC;////////////////////////////////////NUEVO CARACTER///////////////////////////////////
CALL	Retardo_20ms
CALL	Retardo_20ms
	CLRF	LATB
	RETURN