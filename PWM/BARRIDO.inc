;------- Declaracion de variables --------;
;;;;;;;;;;;;;;;;;;;;;;;;;;;;;;;;;;;;;;;;;;;
	CBLOCK
	ANTERIOR
	PRIMERO
	SEGUNDO
	BIT
	CL
	CH
	CARACTER
	CARACTER1
	ENDC
;======================================================================================
BARRIDO
	BCF		INTCON,GIE
	INCF	BIT
	;FILA 4 ////////////////////////////////////////////////////////////////
	BCF		LATB,4
	BSF		LATB,5
	BSF		LATB,6
	BSF		LATB,7

	BTFSC	PORTB,RB0 ; TECLA 1
	GOTO	NEXT0
	MOVLW	'1'
	BTFSS	BIT,0;SE REPRESENTA EL 10% EN BINARIO = 75
	GOTO	UNO
	MOVWF	CARACTER
	MOVLW	0X00
	MOVWF	CH
	MOVLW	0X4B
	MOVWF	CL
	GOTO 	FINBARRIDO
UNO	
	MOVLW	'1'
	MOVWF	CARACTER1
	MOVLW	D'8';SE REPRESENTA EL 1% EN BINARIO = 8
	ADDWF	CL
	BTFSC	STATUS,C
	INCF	CH
	GOTO	FINBARRIDO
NEXT0
	BTFSC	PORTB,RB1 ; TECLA 4
	GOTO	NEXTGATO
	MOVLW	'4'
	BTFSS	BIT,0;SE REPRESENTA EL 40% EN BINARIO = 300
	GOTO	CUATRO
	MOVWF	CARACTER
	MOVLW	0X01
	MOVWF	CH
	MOVLW	0X2C
	MOVWF	CL
	GOTO 	FINBARRIDO
CUATRO	
	MOVLW	'4'
	MOVWF	CARACTER1
	MOVLW	D'30';SE REPRESENTA EL 4% EN BINARIO = 30
	ADDWF	CL
	BTFSC	STATUS,C
	INCF	CH
	GOTO	FINBARRIDO
NEXTGATO
	BTFSC	PORTB,RB2 ; TECLA 7
	GOTO	NEXTD
	MOVLW	'7'
	BTFSS	BIT,0;SE REPRESENTA EL 70% EN BINARIO = 525
	GOTO	SIETE
	MOVWF	CARACTER
	MOVLW	0X02
	MOVWF	CH
	MOVLW	0X0D
	MOVWF	CL
	GOTO 	FINBARRIDO
SIETE	
	MOVLW	'7'
	MOVWF	CARACTER1
	MOVLW	D'53';SE REPRESENTA EL 7% EN BINARIO = 53
	ADDWF	CL
	BTFSC	STATUS,C
	INCF	CH
	GOTO	FINBARRIDO
NEXTD	
NEXTF1	;FILA1 ////////////////////////////////////////////////////////////
	BSF		LATB,4
	BCF		LATB,7

	BTFSC	PORTB,RB0; TECLA A
	GOTO	NEXT2
	MOVLW	'A'
	MOVWF	CARACTER
	GOTO 	FINBARRIDO
NEXT2
	BTFSC	PORTB,RB1 ; TECLA B
	GOTO	NEXT3
	MOVLW	'B'
	MOVWF	CARACTER	
	GOTO 	FINBARRIDO
NEXT3
	BTFSC	PORTB,RB2 ; TECLA C
	GOTO	NEXTF2
	MOVLW	'0'
	BTFSS	BIT,0;SE REPRESENTA EL 0% EN BINARIO = 1
	GOTO	CERO
	MOVWF	CARACTER
	CLRF	CH
	CLRF	CL
CERO
	MOVLW	'0'
	MOVWF	CARACTER1	
	GOTO 	FINBARRIDO
NEXTF2	;FILA 2 ////////////////////////////////////////////////////////////
	BSF		LATB,7
	BCF		LATB,6

	BTFSC	PORTB,RB0 ; TECLA 3
	GOTO	NEXT5
	MOVLW	'3'
	BTFSS	BIT,0;SE REPRESENTA EL 30% EN BINARIO = 225
	GOTO	TRES
	MOVWF	CARACTER
	MOVLW	0X00
	MOVWF	CH
	MOVLW	0XE1
	MOVWF	CL
	GOTO 	FINBARRIDO
TRES	
	MOVLW	'3'
	MOVWF	CARACTER1
	MOVLW	D'23';SE REPRESENTA EL 3% EN BINARIO = 23
	ADDWF	CL
	BTFSC	STATUS,C
	INCF	CH
	GOTO 	FINBARRIDO
NEXT5
	BTFSC	PORTB,RB1 ; TECLA 6
	GOTO	NEXT6
	MOVLW	'6'
	BTFSS	BIT,0;SE REPRESENTA EL 60% EN BINARIO = 450
	GOTO	SEIS
	MOVWF	CARACTER
	MOVLW	0X01
	MOVWF	CH
	MOVLW	0XC2
	MOVWF	CL
	GOTO 	FINBARRIDO
SEIS	
	MOVLW	'6'
	MOVWF	CARACTER1
	MOVLW	D'45';SE REPRESENTA EL 6% EN BINARIO = 45
	ADDWF	CL
	BTFSC	STATUS,C
	INCF	CH
	GOTO 	FINBARRIDO
NEXT6
	BTFSC	PORTB,RB2 ; TECLA 9
	GOTO	NEXTB
	MOVLW	'9'
	BTFSS	BIT,0;SE REPRESENTA EL 90% EN BINARIO = 675
	GOTO	NUEVE
	MOVWF	CARACTER
	MOVLW	0X02
	MOVWF	CH
	MOVLW	0XA3
	MOVWF	CL
	GOTO 	FINBARRIDO
NUEVE	
	MOVLW	'9'
	MOVWF	CARACTER1
	MOVLW	D'68';SE REPRESENTA EL 9% EN BINARIO = 68
	ADDWF	CL
	BTFSC	STATUS,C
	INCF	CH
	GOTO 	FINBARRIDO
NEXTB
NEXTF3	;FILA 3 ////////////////////////////////////////////////////////////
	BSF		LATB,6
	BCF		LATB,5

	BTFSC	PORTB,RB0 ; TECLA 2
	GOTO	NEXT8
	MOVLW	'2'
	BTFSS	BIT,0;SE REPRESENTA EL 20% EN BINARIO = 150
	GOTO	DOS
	MOVWF	CARACTER
	MOVLW	0X00
	MOVWF	CH
	MOVLW	0X96
	MOVWF	CL
	GOTO 	FINBARRIDO
DOS	
	MOVLW	'2'
	MOVWF	CARACTER1
	MOVLW	D'15';SE REPRESENTA EL 2% EN BINARIO = 15
	ADDWF	CL
	BTFSC	STATUS,C
	INCF	CH
	GOTO 	FINBARRIDO
NEXT8		
	BTFSC	PORTB,RB1 ; TECLA 5
	GOTO	NEXT9
	MOVLW	'5'
	BTFSS	BIT,0;SE REPRESENTA EL 50% EN BINARIO = 375
	GOTO	CINCO
	MOVWF	CARACTER
	MOVLW	0X01
	MOVWF	CH
	MOVLW	0X77
	MOVWF	CL
	GOTO 	FINBARRIDO
CINCO
	MOVLW	'5'
	MOVWF	CARACTER1
	MOVLW	D'38';SE REPRESENTA EL 5% EN BINARIO = 38
	ADDWF	CL
	BTFSC	STATUS,C
	INCF	CH
	GOTO 	FINBARRIDO
NEXT9	
	BTFSC	PORTB,RB2 ; TECLA 8
	GOTO	NEXTC
	MOVLW	'8'
	BTFSS	BIT,0;SE REPRESENTA EL 80% EN BINARIO = 600
	GOTO	OCHO
	MOVWF	CARACTER
	MOVLW	0X02
	MOVWF	CH
	MOVLW	0X58
	MOVWF	CL
	GOTO 	FINBARRIDO
OCHO
	MOVLW	'8'
	MOVWF	CARACTER1
	MOVLW	D'60';SE REPRESENTA EL 8% EN BINARIO = 60
	ADDWF	CL
	BTFSC	STATUS,C
	INCF	CH
	GOTO 	FINBARRIDO
NEXTC
	BTFSC	PORTB,RB3 ; TECLA NO USADA
	GOTO	FINBARRIDO
	MOVLW	'C'
	MOVWF	CARACTER	
	GOTO 	FINBARRIDO
FINBARRIDO
	BTFSS	BIT,1
	GOTO	OUT
;////////////////////////////////////CAMBIO PWM///////////////////////////////////
	CLRF	BIT
	CALL	LCD_RETURN_HOME
	MOVF	CARACTER,W
	CALL	LCD_CARACTER
	MOVF	CARACTER1,W
	CALL	LCD_CARACTER
	BCF		CCP2CON,4
	BCF		CCP2CON,5
	BTFSC	CL,0
	BSF		CCP2CON,4
	BTFSC	CL,1
	BSF		CCP2CON,5
	RRNCF	CL
	RRNCF	CL
	BCF		CL,7
	BCF		CL,6
	BTFSC	CH,0
	BSF		CL,6
	BTFSC	CH,1
	BSF		CL,7
	MOVF	CL,W
	MOVWF	CCPR2L
	CALL	Delay

OUT;///////////SUBIDA DEL CARACTER AL LCD////////////////////////////////////////
	CALL	Delay
	RETURN
