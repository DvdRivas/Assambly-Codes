;------- Declaracion de variables --------;
;;;;;;;;;;;;;;;;;;;;;;;;;;;;;;;;;;;;;;;;;;;
	CBLOCK
	ANTERIOR
	BIT
	PRIMERO
	SEGUNDO
	COUNT
	TENP
	ONEP
	ENDC
;======================================================================================	
BARRIDO
	BCF		INTCON,GIE
	CLRF	CAMBIO
	INCF	BIT
	MOVLW	D'75'
	MOVWF	TENP
	MOVLW	D'7'
	MOVWF	ONEP
	;FILA 4 ////////////////////////////////////////////////////////////////
	BCF		LATB,4
	BSF		LATB,5
	BSF		LATB,6
	BSF		LATB,7

	BTFSC	PORTB,RB0 ; TECLA 1
	GOTO	NEXT0
	BSF	CAMBIO,0
	MOVLW	'1'
	MOVWF	TEMP
	MOVLW	0X01
	BTFSC	BIT,0
	MOVWF	PRIMERO
	BTFSC	BIT,1
	MOVWF	SEGUNDO
	GOTO	FINBARRIDO
NEXT0
	BTFSC	PORTB,RB1 ; TECLA 4
	GOTO	NEXTGATO
	BSF	CAMBIO,0
	MOVLW	'4'
	MOVWF	TEMP
	MOVLW	0X04
	BTFSC	BIT,0
	MOVWF	PRIMERO
	BTFSC	BIT,1
	MOVWF	SEGUNDO
	GOTO	FINBARRIDO
NEXTGATO
	BTFSC	PORTB,RB2 ; TECLA 7
	GOTO	NEXTD
	BSF	CAMBIO,0
	MOVLW	'7'
	MOVWF	TEMP
	MOVLW	0X07
	BTFSC	BIT,0
	MOVWF	PRIMERO
	BTFSC	BIT,1
	MOVWF	SEGUNDO
	GOTO	FINBARRIDO
NEXTD	
	BTFSC	PORTB,RB3 ; TECLA NO USADA
	GOTO	NEXTF1
	BSF	CAMBIO,0
	MOVLW	'D'
	MOVWF	TEMP
	GOTO	FINBARRIDO

NEXTF1	;FILA1 ////////////////////////////////////////////////////////////
	BSF		LATB,4
	BCF		LATB,7

	BTFSC	PORTB,RB0; TECLA A
	GOTO	NEXT2
	BSF	CAMBIO,0
	MOVLW	'A'
	MOVWF	TEMP
	BSF	CAMBIO,0
	GOTO 	FINBARRIDO
NEXT2
	BTFSC	PORTB,RB1 ; TECLA B
	GOTO	NEXT3
	BSF	CAMBIO,0
	MOVLW	'B'
	MOVWF	TEMP	
	GOTO 	FINBARRIDO
NEXT3
	BTFSC	PORTB,RB2 ; TECLA C
	GOTO	NEXTA
	BSF	CAMBIO,0
	MOVLW	'0'
	MOVWF	TEMP
	MOVLW	0X00
	BTFSC	BIT,0
	MOVWF	PRIMERO
	BTFSC	BIT,1
	MOVWF	SEGUNDO
	GOTO 	FINBARRIDO
NEXTA
	BTFSC	PORTB,RB3 ; TECLA NO USADA
	GOTO	NEXTF2
	BSF	CAMBIO,0
	MOVLW	'1'
	MOVWF	TEMP	
	GOTO 	FINBARRIDO

NEXTF2	;FILA 2 ////////////////////////////////////////////////////////////
	BSF		LATB,7
	BCF		LATB,6

	BTFSC	PORTB,RB0 ; TECLA 3
	GOTO	NEXT5
	BSF	CAMBIO,0
	MOVLW	'3'
	MOVWF	TEMP
	MOVLW	0X03
	BTFSC	BIT,0
	MOVWF	PRIMERO
	BTFSC	BIT,1
	MOVWF	SEGUNDO
	GOTO 	FINBARRIDO
NEXT5
	BTFSC	PORTB,RB1 ; TECLA 6
	GOTO	NEXT6
	BSF	CAMBIO,0
	MOVLW	'6'
	MOVWF	TEMP
	MOVLW	0X06
	BTFSC	BIT,0
	MOVWF	PRIMERO
	BTFSC	BIT,1
	MOVWF	SEGUNDO
	GOTO 	FINBARRIDO
NEXT6
	BTFSC	PORTB,RB2 ; TECLA 9
	GOTO	NEXTB
	BSF	CAMBIO,0
	MOVLW	'9'
	MOVWF	TEMP
	MOVLW	0X09
	BTFSC	BIT,0
	MOVWF	PRIMERO
	BTFSC	BIT,1
	MOVWF	SEGUNDO
	GOTO 	FINBARRIDO
NEXTB
	BTFSC	PORTB,RB3 ; TECLA NO USADA
	GOTO	NEXTF3
	BSF	CAMBIO,0
	MOVLW	'B'
	MOVWF	TEMP	
	GOTO 	FINBARRIDO

NEXTF3	;FILA 3 ////////////////////////////////////////////////////////////
	BSF		LATB,6
	BCF		LATB,5

	BTFSC	PORTB,RB0 ; TECLA 2
	GOTO	NEXT8
	BSF	CAMBIO,0
	MOVLW	'2'
	MOVWF	TEMP
	MOVLW	0X02
	BTFSC	BIT,0
	MOVWF	PRIMERO
	BTFSC	BIT,1
	MOVWF	SEGUNDO
	GOTO 	FINBARRIDO
NEXT8		
	BTFSC	PORTB,RB1 ; TECLA 5
	GOTO	NEXT9
	BSF	CAMBIO,0
	MOVLW	'5'
	MOVWF	TEMP
	MOVLW	0X05
	BTFSC	BIT,0
	MOVWF	PRIMERO
	BTFSC	BIT,1
	MOVWF	SEGUNDO
	GOTO 	FINBARRIDO
NEXT9	
	BTFSC	PORTB,RB2 ; TECLA 8
	GOTO	NEXTC
	BSF	CAMBIO,0
	MOVLW	'8'
	MOVWF	TEMP
	MOVLW	0X08
	BTFSC	BIT,0
	MOVWF	PRIMERO
	BTFSC	BIT,1
	MOVWF	SEGUNDO
NEXTC
	BTFSC	PORTB,RB3 ; TECLA NO USADA
	GOTO	FINBARRIDO
	BSF	CAMBIO,0
	MOVLW	'C'
	MOVWF	TEMP	
	GOTO 	FINBARRIDO
FINBARRIDO
	MOVF	TEMP,W
	MOVWF	CARACTER
	BTFSS	BIT,1
	GOTO	ENDED
;////////////////////////////////////NUEVO CARACTER///////////////////////////////////
UPLOAD
	CLRF	TMR0H
	CLRF	TMR0L
	CLRF	TEMP
	CLRF	COUNT
	INCF	PRIMERO
	INCF	SEGUNDO
SUMAP
	DECFSZ	PRIMERO
	GOTO	KEEP
	GOTO	SUMAS
KEEP
	MOVF	TENP,W
	ADDWFC	ADRESL,F	
	GOTO	SUMAP
SUMAS
	DECFSZ	SEGUNDO
	GOTO	KEEP2
	GOTO	ENDED
KEEP2
	MOVF	TENP,W
	ADDWF	ADRESL,F
	GOTO	SUMAS
ENDED
	CALL	Retardo_20ms
	CALL	Retardo_20ms
	CLRF	BIT
	RETURN
