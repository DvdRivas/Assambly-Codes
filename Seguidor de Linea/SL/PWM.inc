PWM
	RLNCF	CENTENA,W
	CALL 	MAX
	MOVWF	TEMP
	CALL	SOR	
;	RLNCF	DECENA,W
;	CALL 	MIN
;	CPFSLT	MEDIA
;	GOTO 	RESTA
;	GOTO	SUMA
	BCF		CCP2CON,4
	BCF		CCP2CON,5
	BTFSC	CL,0
	BSF		CCP2CON,4
	BTFSC	CL,1
	BSF		CCP2CON,5
	RRNCF	CL
	RRNCF	CL
	BCF		CL,7
	BCF		CL,6
	BTFSC	CH,0
	BSF		CL,6
	BTFSC	CH,1
	BSF		CL,7
	MOVFF	CL,CCPR2L
	RETURN
MAX
	ADDWF	PCL,F
	RETLW	D'183'  ;25
	RETLW	D'150'	;20
	RETLW	D'113'	;15
	RETLW	D'75'	;10
	RETLW	D'38'	;5
	RETLW	D'0'	;0
	RETLW	D'38'	;5
	RETLW	D'75'	;10
	RETLW	D'113'	;15
	RETLW	D'150'	;20
MIN
	ADDWF	PCL,F
	RETLW	D'15'	;2
	RETLW	D'8'	;1
	RETLW	D'8'	;1
	RETLW	D'8'	;1
	RETLW	D'0'	;0
	RETLW	D'0'	;0
	RETLW	D'0'	;0
	RETLW	D'8'	;1
	RETLW	D'8'	;1
	RETLW	D'8'	;1
