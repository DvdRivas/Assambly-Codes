;------- Declaracion de variables --------;
;;;;;;;;;;;;;;;;;;;;;;;;;;;;;;;;;;;;;;;;;;;
	CBLOCK
	NUMERO
	NUM1
	NUM2
	BIT
	NUMB
	NUMA
	CARACTER
	CARACTER1
	ENDC
;======================================================================================
BARRIDO
	CALL	B2BCD2
	BTFSS	BIT,0
	MOVFF	NUM1,NUMERO
	BTFSC	BIT,0
	MOVFF	NUM2,NUMERO
	INCF	BIT
	;FILA 4 ////////////////////////////////////////////////////////////////
	MOVLW	D'1'
	CPFSEQ	NUMERO	 ; TECLA 1
	GOTO	NEXT0
	MOVLW	'1'
	BTFSS	BIT,0;SE REPRESENTA EL 10% EN BINARIO = 75
	GOTO	UNO
	MOVWF	CARACTER
	MOVLW	0X00
	MOVWF	NUMA
	MOVLW	0X4B
	MOVWF	NUMB
	GOTO 	FINBARRIDO
UNO	
	MOVLW	'1'
	MOVWF	CARACTER1
	MOVLW	D'8';SE REPRESENTA EL 1% EN BINARIO = 8
	ADDWF	NUMB
	BTFSC	STATUS,C
	INCF	NUMA
	GOTO	FINBARRIDO
NEXT0
	MOVLW	D'4'
	CPFSEQ	NUMERO	 ; TECLA 4
	GOTO	NEXTGATO
	MOVLW	'4'
	BTFSS	BIT,0;SE REPRESENTA EL 40% EN BINARIO = 300
	GOTO	CUATRO
	MOVWF	CARACTER
	MOVLW	0X01
	MOVWF	NUMA
	MOVLW	0X2C
	MOVWF	NUMB
	GOTO 	FINBARRIDO
CUATRO	
	MOVLW	'4'
	MOVWF	CARACTER1
	MOVLW	D'30';SE REPRESENTA EL 4% EN BINARIO = 30
	ADDWF	NUMB
	BTFSC	STATUS,C
	INCF	NUMA
	GOTO	FINBARRIDO
NEXTGATO
	MOVLW	D'7'
	CPFSEQ	NUMERO	 ; TECLA 7
	GOTO	NEXTD
	MOVLW	'7'
	BTFSS	BIT,0;SE REPRESENTA EL 70% EN BINARIO = 525
	GOTO	SIETE
	MOVWF	CARACTER
	MOVLW	0X02
	MOVWF	NUMA
	MOVLW	0X0D
	MOVWF	NUMB
	GOTO 	FINBARRIDO
SIETE	
	MOVLW	'7'
	MOVWF	CARACTER1
	MOVLW	D'53';SE REPRESENTA EL 7% EN BINARIO = 53
	ADDWF	NUMB
	BTFSC	STATUS,C
	INCF	NUMA
	GOTO	FINBARRIDO
NEXTD	
NEXTF1	;FILA1 ////////////////////////////////////////////////////////////
	MOVLW	D'0'
	CPFSEQ	NUMERO	 ; TECLA 0
	GOTO	NEXTF2
	MOVLW	'0'
	BTFSS	BIT,0;SE REPRESENTA EL 0% EN BINARIO = 1
	GOTO	CERO
	MOVWF	CARACTER
	CLRF	NUMA
	CLRF	NUMB
CERO
	MOVLW	'0'
	MOVWF	CARACTER1	
	GOTO 	FINBARRIDO
NEXTF2	;FILA 2 ////////////////////////////////////////////////////////////
	MOVLW	D'3'
	CPFSEQ	NUMERO	 ; TECLA 3
	GOTO	NEXT5
	MOVLW	'3'
	BTFSS	BIT,0;SE REPRESENTA EL 30% EN BINARIO = 225
	GOTO	TRES
	MOVWF	CARACTER
	MOVLW	0X00
	MOVWF	NUMA
	MOVLW	0XE1
	MOVWF	NUMB
	GOTO 	FINBARRIDO
TRES	
	MOVLW	'3'
	MOVWF	CARACTER1
	MOVLW	D'23';SE REPRESENTA EL 3% EN BINARIO = 23
	ADDWF	NUMB
	BTFSC	STATUS,C
	INCF	NUMA
	GOTO 	FINBARRIDO
NEXT5
	MOVLW	D'6'
	CPFSEQ	NUMERO	 ; TECLA 6
	GOTO	NEXT6
	MOVLW	'6'
	BTFSS	BIT,0;SE REPRESENTA EL 60% EN BINARIO = 450
	GOTO	SEIS
	MOVWF	CARACTER
	MOVLW	0X01
	MOVWF	NUMA
	MOVLW	0XC2
	MOVWF	NUMB
	GOTO 	FINBARRIDO
SEIS	
	MOVLW	'6'
	MOVWF	CARACTER1
	MOVLW	D'45';SE REPRESENTA EL 6% EN BINARIO = 45
	ADDWF	NUMB
	BTFSC	STATUS,C
	INCF	NUMA
	GOTO 	FINBARRIDO
NEXT6
	MOVLW	D'9'
	CPFSEQ	NUMERO	 ; TECLA 9
	GOTO	NEXTB
	MOVLW	'9'
	BTFSS	BIT,0;SE REPRESENTA EL 90% EN BINARIO = 675
	GOTO	NUEVE
	MOVWF	CARACTER
	MOVLW	0X02
	MOVWF	NUMA
	MOVLW	0XA3
	MOVWF	NUMB
	GOTO 	FINBARRIDO
NUEVE	
	MOVLW	'9'
	MOVWF	CARACTER1
	MOVLW	D'68';SE REPRESENTA EL 9% EN BINARIO = 68
	ADDWF	NUMB
	BTFSC	STATUS,C
	INCF	NUMA
	GOTO 	FINBARRIDO
NEXTB
NEXTF3	;FILA 3 ////////////////////////////////////////////////////////////
	MOVLW	D'2'
	CPFSEQ	NUMERO	 ; TECLA 2
	GOTO	NEXT8
	MOVLW	'2'
	BTFSS	BIT,0;SE REPRESENTA EL 20% EN BINARIO = 150
	GOTO	DOS
	MOVWF	CARACTER
	MOVLW	0X00
	MOVWF	NUMA
	MOVLW	0X96
	MOVWF	NUMB
	GOTO 	FINBARRIDO
DOS	
	MOVLW	'2'
	MOVWF	CARACTER1
	MOVLW	D'15';SE REPRESENTA EL 2% EN BINARIO = 15
	ADDWF	NUMB
	BTFSC	STATUS,C
	INCF	NUMA
	GOTO 	FINBARRIDO
NEXT8		
	MOVLW	D'5'
	CPFSEQ	NUMERO	 ; TECLA 5
	GOTO	NEXT9
	MOVLW	'5'
	BTFSS	BIT,0;SE REPRESENTA EL 50% EN BINARIO = 375
	GOTO	CINCO
	MOVWF	CARACTER
	MOVLW	0X01
	MOVWF	NUMA
	MOVLW	0X77
	MOVWF	NUMB
	GOTO 	FINBARRIDO
CINCO
	MOVLW	'5'
	MOVWF	CARACTER1
	MOVLW	D'38';SE REPRESENTA EL 5% EN BINARIO = 38
	ADDWF	NUMB
	BTFSC	STATUS,C
	INCF	NUMA
	GOTO 	FINBARRIDO
NEXT9	
	MOVLW	D'8'
	CPFSEQ	NUMERO	 ; TECLA 8
	GOTO	FINBARRIDO
	MOVLW	'8'
	BTFSS	BIT,0;SE REPRESENTA EL 80% EN BINARIO = 600
	GOTO	OCHO
	MOVWF	CARACTER
	MOVLW	0X02
	MOVWF	NUMA
	MOVLW	0X58
	MOVWF	NUMB
	GOTO 	FINBARRIDO
OCHO
	MOVLW	'8'
	MOVWF	CARACTER1
	MOVLW	D'60';SE REPRESENTA EL 8% EN BINARIO = 60
	ADDWF	NUMB
	BTFSC	STATUS,C
	INCF	NUMA
FINBARRIDO
	BTFSS	BIT,1
	
	GOTO	OUT
;////////////////////////////////////CAMBIO PWM///////////////////////////////////
	BTFSS	BIT2,0	
	GOTO	MOTORIZQ	;SENSOR 1
	GOTO	MOTORDER	;SENSOR 2
MOTORIZQ
	CLRF	BIT
	CALL	LCD_RETURN_HOME
	MOVF	CARACTER,W
	CALL	LCD_CARACTER
	MOVF	CARACTER1,W
	CALL	LCD_CARACTER
	BCF		CCP2CON,4
	BCF		CCP2CON,5
	BTFSC	NUMB,0
	BSF		CCP2CON,4
	BTFSC	NUMB,1
	BSF		CCP2CON,5
	RRNCF	NUMB
	RRNCF	NUMB
	BCF		NUMB,7
	BCF		NUMB,6
	BTFSC	NUMA,0
	BSF		NUMB,6
	BTFSC	NUMA,1
	BSF		NUMB,7
	MOVF	NUMB,W
	MOVWF	CCPR2L
	MOVFF	TOTAL,SUMA1	
	GOTO OUT
MOTORDER
	CLRF	BIT
	CALL	LCD_LINEA2
	MOVF	CARACTER,W
	CALL	LCD_CARACTER
	MOVF	CARACTER1,W
	CALL	LCD_CARACTER
	BCF		CCP1CON,4
	BCF		CCP1CON,5
	BTFSC	NUMB,0
	BSF		CCP1CON,4
	BTFSC	NUMB,1
	BSF		CCP1CON,5
	RRNCF	NUMB
	RRNCF	NUMB
	BCF		NUMB,7
	BCF		NUMB,6
	BTFSC	NUMA,0
	BSF		NUMB,6
	BTFSC	NUMA,1
	BSF		NUMB,7
	MOVF	NUMB,W
	MOVWF	CCPR1L
	MOVFF	TOTAL,SUMA2
OUT;///////////SUBIDA DEL CARACTER AL LCD////////////////////////////////////////
	BTFSC	BIT,0
	GOTO 	BARRIDO
	RETURN
