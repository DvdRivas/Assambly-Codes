;------- Declaracion de variables --------;
;;;;;;;;;;;;;;;;;;;;;;;;;;;;;;;;;;;;;;;;;;;
	CBLOCK
	ANTERIOR
	ENDC
;======================================================================================
BARRIDO
	MOVF	CARACTER,W
	MOVWF	ANTERIOR
	CLRF	CAMBIO
	
	;FILA 4 ////////////////////////////////////////////////////////////////
	BCF		LATB,4
	BSF		LATB,5
	BSF		LATB,6
	BSF		LATB,7



	BTFSC	PORTB,RB3 ; TECLA *
	GOTO	NEXT0
	BSF	CAMBIO,0
	MOVLW	'*'
	MOVWF	TEMP
	GOTO	FINBARRIDO
NEXT0
	BTFSC	PORTB,RB2 ; TECLA 0
	GOTO	NEXTGATO
	BSF	CAMBIO,0
	MOVLW	'0'
	MOVWF	TEMP
	GOTO	FINBARRIDO
NEXTGATO
	BTFSC	PORTB,RB1 ; TECLA #
	GOTO	NEXTD
	BSF	CAMBIO,0
	MOVLW	'#'
	MOVWF	TEMP
	GOTO	FINBARRIDO
NEXTD	
	BTFSC	PORTB,RB0 ; TECLA D
	GOTO	NEXTF1
	BSF	CAMBIO,0
	MOVLW	'D'
	MOVWF	TEMP
	GOTO	FINBARRIDO

NEXTF1	;FILA1 ////////////////////////////////////////////////////////////
	BSF		LATB,4
	BCF		LATB,7

	BTFSC	PORTB,RB3; TECLA 1
	GOTO	NEXT2
	BSF	CAMBIO,0
	MOVLW	'1'
	MOVWF	TEMP
	BSF	CAMBIO,0
	GOTO 	FINBARRIDO
NEXT2
	BTFSC	PORTB,RB2 ; TECLA 2
	GOTO	NEXT3
	BSF	CAMBIO,0
	MOVLW	'2'
	MOVWF	TEMP	
	GOTO 	FINBARRIDO
NEXT3
	BTFSC	PORTB,RB1 ; TECLA 3
	GOTO	NEXTA
	BSF	CAMBIO,0
	MOVLW	'3'
	MOVWF	TEMP	
	GOTO 	FINBARRIDO
NEXTA
	BTFSC	PORTB,RB0 ; TECLA A
	GOTO	NEXTF2
	BSF	CAMBIO,0
	MOVLW	'A'
	MOVWF	TEMP	
	GOTO 	FINBARRIDO

NEXTF2	;FILA 2 ////////////////////////////////////////////////////////////
	BSF		LATB,7
	BCF		LATB,6

	BTFSC	PORTB,RB3 ; TECLA 4
	GOTO	NEXT5
	BSF	CAMBIO,0
	MOVLW	'4'
	MOVWF	TEMP
	GOTO 	FINBARRIDO
NEXT5
	BTFSC	PORTB,RB2 ; TECLA 5
	GOTO	NEXT6
	BSF	CAMBIO,0
	MOVLW	'5'
	MOVWF	TEMP
	GOTO 	FINBARRIDO
NEXT6
	BTFSC	PORTB,RB1 ; TECLA 6
	GOTO	NEXTB
	BSF	CAMBIO,0
	MOVLW	'6'
	MOVWF	TEMP
	GOTO 	FINBARRIDO
NEXTB
	BTFSC	PORTB,RB0 ; TECLA B
	GOTO	NEXTF3
	BSF	CAMBIO,0
	MOVLW	'B'
	MOVWF	TEMP	
	GOTO 	FINBARRIDO

NEXTF3	;FILA 3 ////////////////////////////////////////////////////////////
	BSF		LATB,6
	BCF		LATB,5

	BTFSC	PORTB,RB3 ; TECLA 7
	GOTO	NEXT8
	BSF	CAMBIO,0
	MOVLW	'7'
	MOVWF	TEMP
	GOTO 	FINBARRIDO
NEXT8		
	BTFSC	PORTB,RB2 ; TECLA 8
	GOTO	NEXT9
	BSF	CAMBIO,0
	MOVLW	'8'
	MOVWF	TEMP
	GOTO 	FINBARRIDO
NEXT9	
	BTFSC	PORTB,RB1 ; TECLA 9
	GOTO	NEXTC
	BSF	CAMBIO,0
	MOVLW	'9'
	MOVWF	TEMP
NEXTC
	BTFSC	PORTB,RB0 ; TECLA C
	GOTO	FINBARRIDO
	BSF	CAMBIO,0
	MOVLW	'C'
	MOVWF	TEMP	
	GOTO 	FINBARRIDO
FINBARRIDO
	BTFSC	CAMBIO,0
	GOTO	NEWC
;/////////////////////////////////////////SIN CAMBIOS/////////////////////////////////////	
	CLRF	WREG
	RETURN
NEWC;////////////////////////////////////NUEVO CARACTER///////////////////////////////////
	MOVWF	TEMP
	BSF	DETECTOR,0
;
; DELAY DE MEDIO SEGUNDO PARA EVITAR REBOTE
	movlw	0x0D
	movwf	D1
	movlw	0x46
	movwf	D2
	movlw	0x04
	movwf	D3
Delay_01
	decfsz	D1, f
	goto	SALTO11
	decfsz	D2, f
SALTO11	goto	SALTO21
	decfsz	D3, f
SALTO21 goto	Delay_01	
	MOVF	TEMP,W
	MOVWF	CARACTER
	RETURN