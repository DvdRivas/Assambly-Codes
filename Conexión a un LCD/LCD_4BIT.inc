	CBLOCK 0X000
	LCD_DATO
	LCD_GUARDADATO
	LCD_GUARDATRISD
	ENDC
	#define LCD_E LATD,4
	#define LCD_RS LATD,5
	#define LCD_BUSDATOS LATD

LCD_Inicializa
	BSF		STATUS,0
	BCF		LCD_E
	BCF		LCD_RS
	BCF		STATUS,0

	BCF		LCD_E
	BCF		LCD_RS

   	CALL	Retardo_20ms ;Esperar 20 ms
	CALL   	Retardo_5ms ;Esperar 5ms

	MOVLW 	B'00000011'
	CALL	LCD_ESCRIBE
	CALL   	Retardo_5ms ;Esperar 5ms

   	MOVLW  	B'00000011' 
	CALL	LCD_ESCRIBE
   	CALL   	Retardo_50us ;Acumular 50us
   	CALL   	Retardo_50us ;Acumular 100us

	MOVLW 	B'00000011' 
	CALL	LCD_ESCRIBE
   	CALL   	Retardo_50us ;Acumular 50us
   	CALL   	Retardo_50us ;Acumular 100us

	MOVLW 	B'00000010' 
	CALL	LCD_ESCRIBE
   	CALL   	Retardo_50us ;Acumular 50us
   	CALL   	Retardo_50us ;Acumular 100us

	CALL	LCD_BORRA
	CALL	LCD_2LINEAS4BITS
	CALL	LCD_CURSORON
   return
 	
LCD_CURSORINCR
	MOVLW	B'00000110'
	GOTO	LCD_ENVIACOMANDO	

LCD_LINEA1
	MOVLW	B'10000000'
	GOTO	LCD_ENVIACOMANDO

LCD_LINEA2
	MOVLW	B'11000000'
	GOTO	LCD_ENVIACOMANDO
	RETURN

LCD_POSICIONLINEA1
	IORLW	B'10000000'
	GOTO	LCD_ENVIACOMANDO

LCD_POSICIONLINEA2
	IORLW	B'11000000'
	GOTO	LCD_ENVIACOMANDO

LCD_OFF
	MOVLW	B'00001000'
	GOTO	LCD_ENVIACOMANDO

LCD_CURSORON
	MOVLW	B'00001110'
	GOTO	LCD_ENVIACOMANDO

LCD_CURSOROFF
	MOVLW	B'00001100'
	GOTO	LCD_ENVIACOMANDO

LCD_BORRA
	MOVLW	B'00000001'
	GOTO	LCD_ENVIACOMANDO

LCD_2LINEAS4BITS
	MOVLW	B'00101000'
	GOTO	LCD_ENVIACOMANDO

LCD_ESCRIBE
	ANDLW	B'00001111'
	MOVWF	LCD_DATO
	MOVF	LCD_BUSDATOS,W
	ANDLW	B'00110000'
	IORWF	LCD_DATO,F

	BSF		STATUS,0
	MOVF	TRISD,W
	MOVWF	LCD_GUARDATRISD
	MOVLW	B'00110000'
	ANDWF	LATD,F
	BCF		STATUS,0

	MOVF	LCD_DATO,W
	MOVWF	LCD_BUSDATOS
	BSF		LCD_E
	BCF		LCD_E	
	BSF		STATUS,0
	MOVF	LCD_GUARDATRISD,W
	MOVWF	LATD
	BCF		STATUS,0
	RETURN
LCD_ENVIACOMANDO
   	BCF    	LCD_RS 
    GOTO	LCD_ENVIA

LCD_CARACTER
   	BCF    	LCD_RS 
    GOTO	LCD_CGROM

LCD_ENVIA
	MOVWF	LCD_GUARDADATO
	CALL	LCD_ESCRIBE
	SWAPF	LCD_GUARDADATO,W
	CALL	LCD_ESCRIBE
	BTFSS	LCD_RS
	CALL 	Retardo_2ms
	CALL	Retardo_50us
 	RETURN

LCD_CGROM
	MOVF	LCD_DATO,W
RETURN
include<LCD_Retardo.inc>
